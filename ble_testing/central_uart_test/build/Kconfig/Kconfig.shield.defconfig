## ble_testing/central_uart_test/build/Kconfig/boards/Kconfig.nrf52840dongle
```kconfig
# Load board Kconfig descriptions.
osource "C:/ncs/v3.3.0/zephyr/boards/nordic/nrf52840dongle/Kconfig.nrf52840dongle"
```

## ble_testing/peripheral_nus_test/build/Kconfig/boards/Kconfig.tmp
```kconfig
# Load Zephyr board Kconfig descriptions.
osource "C:/ncs/v3.3.0/zephyr/boards/others/promicro_nrf52840/Kconfig"
```
